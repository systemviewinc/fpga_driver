## yocto/poky/meta-vsi/conf/layer.conf
```bitbake
# We have a conf and classes directory, add to BBPATH
BBPATH .= ":${LAYERDIR}"

# We have a packages directory, add to BBFILES
BBFILES += "${LAYERDIR}/recipes-*/*/*.bb"
BBFILES += "${LAYERDIR}/recipes-*/*/*.bbappend"

BBFILE_COLLECTIONS += "vsi"
BBFILE_PATTERN_vsi = "^${LAYERDIR}/"
BBFILE_PRIORITY_vsi = "1"

#LAYERDEPENDS_vsi = "core"
```
