	amba_pl@0 {
		#address-cells = <0x2>;
		#size-cells = <0x1>;
		compatible = "simple-bus";
		ranges;

		sv_driver_plat@B0000000 {
			compatible = "xlnx,sv_driver_plat";
			interrupt-parent = <0x4>;
			interrupts = <0x0 106 0x4>;
			reg = <0x0 0xb0000000 0x2000000>;
		};
	};
