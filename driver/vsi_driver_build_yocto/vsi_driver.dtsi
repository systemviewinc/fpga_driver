	amba {
		compatible = "simple-bus";
		u-boot,dm-pre-reloc;
		#address-cells = <0x2>;
		#size-cells = <0x2>;

		vsi_driver_plat@80000000 {
		 	compatible = "xlnx,sv_driver_plat";
			interrupt-parent = <0x4>;
			interrupts = <0x0 0x59 0x4>;
			reg = <0x0 0x80000000 0x0 0x0008000 0x0 0x88000000 0x0 0x08000000>;
		};
	};		
