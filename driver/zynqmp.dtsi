		sv_driver_plat@80000000 {
			compatible = "xlnx,sv_driver_plat";
			interrupts = <0x0 0x59 0x1>;
			interrupt-parent = <0x4>;
			reg = <0x0 0x80000000 0x0 0x0000f000 0x0 0x88000000 0x0 0x04000000 0x0 0x8c000000 0x0 0x04000000>;
		};
